## DevOps/Yocto/Practices/quickstart/meta-quickstart/conf/layer.conf
```bitbake
# Paths for config files (under the conf directory) and class files (under the classes directory).
# BBPATH is recursive. This means all sub-directives in BBPATH will be searched.
# LAYERDIR is the layer directory.
BBPATH .= ":${LAYERDIR}"

# Names for recipe files (.bb) and append files (.bbappend).
# We use wildcard here. So all files with ".bb" extension will be get.
BBFILES += "${LAYERDIR}/recipes-*/*/*.bb"

# Append layer name to list of configured layers
# Then we can use the layer name as suffix for other properties
BBFILE_COLLECTIONS += "quickstart"

# Expand to match files from BBFILES in a particular layer.
BBFILE_PATTERN_quickstart = "^${LAYERDIR}/"

# Specify the priority for recipe files in each layer.
BBFILE_PRIORITY_quickstart = "5"

# Set the core name for the layer series.
# Here we put this variable in meta-quickstart/conf/layer.conf, but we can also define it in the build/conf/bblayers.conf file, or in any other layer.
LAYERSERIES_CORENAMES = "bitbakeguilde"

# Specify that the "quickstart" layer is compatible with the "bitbakeguilde" layer series
LAYERSERIES_COMPAT_quickstart = "bitbakeguilde"

# Specify the layer version
LAYERVERSION_quickstart = "1"
```

## DevOps/Yocto/Practices/quickstart/meta-two/conf/layer.conf
```bitbake
BBPATH .= ":${LAYERDIR}"
BBFILES += " \
    ${LAYERDIR}/recipes-*/*/*.bb \
    ${LAYERDIR}/recipes-*/*/*.bbappend \
"

BBFILE_COLLECTIONS += "two"
BBFILE_PATTERN_two = "^${LAYERDIR}/"
BBFILE_PRIORITY_two = "5"
LAYERVERSION_two = "1"

# Specify that the "two" layer is compatible with the "bitbakeguilde"
LAYERSERIES_COMPAT_two = "bitbakeguilde"

# This layer has a dependency to the "quickstart" layer
LAYERDEPENDS_two = "quickstart"
```
